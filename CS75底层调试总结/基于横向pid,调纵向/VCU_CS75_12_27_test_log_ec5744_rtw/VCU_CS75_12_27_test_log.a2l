/******************************************************************************
* ASAP2 file: VCU_CS75_12_27_test_log.a2l
* Code generation for model "VCU_CS75_12_27_test_log".
* Model version : 1.2787
* Simulink Coder version : 8.6 (R2014a) 27-Dec-2013
* C source code generated on : Sun Dec 27 21:26:44 2020
* Target selection: ec5744.tlc
* Embedded hardware selection: Freescale MPC5500
* Code generation objectives: Unspecified
* Validation result: Not run
* (add additional file header information here)
******************************************************************************/ ASAP2_VERSION 1 31
/* Version 1.31 */
/begin PROJECT ECUCoderProject "ECUCoder Project"
/begin HEADER "Header Comments go here" /end HEADER
/begin MODULE ModuleName "Module Comment Goes Here"
/begin MOD_PAR "MOD PAR Comment Goes Here" /end MOD_PAR
/begin MOD_COMMON "Mod Common Comment Here" BYTE_ORDER MSB_FIRST /end MOD_COMMON
/begin RECORD_LAYOUT Scalar_BOOLEAN FNC_VALUES 1 UBYTE COLUMN_DIR DIRECT /end RECORD_LAYOUT
/begin RECORD_LAYOUT Scalar_UBYTE FNC_VALUES 1 UBYTE COLUMN_DIR DIRECT /end RECORD_LAYOUT
/begin RECORD_LAYOUT Scalar_BYTE FNC_VALUES 1 SBYTE COLUMN_DIR DIRECT /end RECORD_LAYOUT
/begin RECORD_LAYOUT Scalar_UWORD FNC_VALUES 1 UWORD COLUMN_DIR DIRECT /end RECORD_LAYOUT
/begin RECORD_LAYOUT Scalar_SWORD FNC_VALUES 1 SWORD COLUMN_DIR DIRECT /end RECORD_LAYOUT
/begin RECORD_LAYOUT Scalar_ULONG FNC_VALUES 1 ULONG COLUMN_DIR DIRECT /end RECORD_LAYOUT
/begin RECORD_LAYOUT Scalar_LONG FNC_VALUES 1 SLONG COLUMN_DIR DIRECT /end RECORD_LAYOUT
/begin RECORD_LAYOUT Scalar_FLOAT32_IEEE FNC_VALUES 1 FLOAT32_IEEE COLUMN_DIR DIRECT /end RECORD_LAYOUT
/begin RECORD_LAYOUT Scalar_FLOAT64_IEEE FNC_VALUES 1 FLOAT64_IEEE COLUMN_DIR DIRECT /end RECORD_LAYOUT
/begin RECORD_LAYOUT Lookup1D_BOOLEAN FNC_VALUES 1 UBYTE COLUMN_DIR DIRECT /end RECORD_LAYOUT
/begin RECORD_LAYOUT Lookup1D_X_BOOLEAN AXIS_PTS_X 1 UBYTE INDEX_INCR DIRECT /end RECORD_LAYOUT
/begin RECORD_LAYOUT Lookup1D_BYTE FNC_VALUES 1 SBYTE COLUMN_DIR DIRECT /end RECORD_LAYOUT
/begin RECORD_LAYOUT Lookup1D_X_BYTE AXIS_PTS_X 1 SBYTE INDEX_INCR DIRECT /end RECORD_LAYOUT
/begin RECORD_LAYOUT Lookup1D_UBYTE FNC_VALUES 1 UBYTE COLUMN_DIR DIRECT /end RECORD_LAYOUT
/begin RECORD_LAYOUT Lookup1D_X_UBYTE AXIS_PTS_X 1 UBYTE INDEX_INCR DIRECT /end RECORD_LAYOUT
/begin RECORD_LAYOUT Lookup1D_UWORD FNC_VALUES 1 UWORD COLUMN_DIR DIRECT /end RECORD_LAYOUT
/begin RECORD_LAYOUT Lookup1D_X_UWORD AXIS_PTS_X 1 UWORD INDEX_INCR DIRECT /end RECORD_LAYOUT
/begin RECORD_LAYOUT Lookup1D_WORD FNC_VALUES 1 SWORD COLUMN_DIR DIRECT /end RECORD_LAYOUT
/begin RECORD_LAYOUT Lookup1D_X_WORD AXIS_PTS_X 1 SWORD INDEX_INCR DIRECT /end RECORD_LAYOUT
/begin RECORD_LAYOUT Lookup1D_ULONG FNC_VALUES 1 ULONG COLUMN_DIR DIRECT /end RECORD_LAYOUT
/begin RECORD_LAYOUT Lookup1D_X_ULONG AXIS_PTS_X 1 ULONG INDEX_INCR DIRECT /end RECORD_LAYOUT
/begin RECORD_LAYOUT Lookup1D_SLONG FNC_VALUES 1 SLONG COLUMN_DIR DIRECT /end RECORD_LAYOUT
/begin RECORD_LAYOUT Lookup1D_X_LONG AXIS_PTS_X 1 SLONG INDEX_INCR DIRECT /end RECORD_LAYOUT
/begin RECORD_LAYOUT Lookup1D_FLOAT32_IEEE FNC_VALUES 1 FLOAT32_IEEE COLUMN_DIR DIRECT /end RECORD_LAYOUT
/begin RECORD_LAYOUT Lookup1D_X_FLOAT32_IEEE AXIS_PTS_X 1 FLOAT32_IEEE INDEX_INCR DIRECT /end RECORD_LAYOUT
/begin RECORD_LAYOUT Lookup1D_FLOAT64_IEEE FNC_VALUES 1 FLOAT64_IEEE COLUMN_DIR DIRECT /end RECORD_LAYOUT
/begin RECORD_LAYOUT Lookup1D_X_FLOAT64_IEEE AXIS_PTS_X 1 FLOAT64_IEEE INDEX_INCR DIRECT /end RECORD_LAYOUT
/begin RECORD_LAYOUT Lookup2D_BOOLEAN FNC_VALUES 1 UBYTE COLUMN_DIR DIRECT /end RECORD_LAYOUT
/begin RECORD_LAYOUT Lookup2D_X_BOOLEAN AXIS_PTS_X 1 UBYTE INDEX_INCR DIRECT /end RECORD_LAYOUT
/begin RECORD_LAYOUT Lookup2D_UBYTE FNC_VALUES 1 UBYTE COLUMN_DIR DIRECT /end RECORD_LAYOUT
/begin RECORD_LAYOUT Lookup2D_X_UBYTE AXIS_PTS_X 1 UBYTE INDEX_INCR DIRECT /end RECORD_LAYOUT
/begin RECORD_LAYOUT Lookup2D_BYTE FNC_VALUES 1 SBYTE COLUMN_DIR DIRECT /end RECORD_LAYOUT
/begin RECORD_LAYOUT Lookup2D_X_BYTE AXIS_PTS_X 1 SBYTE INDEX_INCR DIRECT /end RECORD_LAYOUT
/begin RECORD_LAYOUT Lookup2D_UWORD FNC_VALUES 1 UWORD COLUMN_DIR DIRECT /end RECORD_LAYOUT
/begin RECORD_LAYOUT Lookup2D_X_UWORD AXIS_PTS_X 1 UWORD INDEX_INCR DIRECT /end RECORD_LAYOUT
/begin RECORD_LAYOUT Lookup2D_WORD FNC_VALUES 1 SWORD COLUMN_DIR DIRECT /end RECORD_LAYOUT
/begin RECORD_LAYOUT Lookup2D_X_WORD AXIS_PTS_X 1 SWORD INDEX_INCR DIRECT /end RECORD_LAYOUT
/begin RECORD_LAYOUT Lookup2D_ULONG FNC_VALUES 1 ULONG COLUMN_DIR DIRECT /end RECORD_LAYOUT
/begin RECORD_LAYOUT Lookup2D_X_ULONG AXIS_PTS_X 1 ULONG INDEX_INCR DIRECT /end RECORD_LAYOUT
/begin RECORD_LAYOUT Lookup2D_LONG FNC_VALUES 1 SLONG COLUMN_DIR DIRECT /end RECORD_LAYOUT
/begin RECORD_LAYOUT Lookup2D_X_LONG AXIS_PTS_X 1 SLONG INDEX_INCR DIRECT /end RECORD_LAYOUT
/begin RECORD_LAYOUT Lookup2D_FLOAT32_IEEE FNC_VALUES 1 FLOAT32_IEEE COLUMN_DIR DIRECT /end RECORD_LAYOUT
/begin RECORD_LAYOUT Lookup2D_X_FLOAT32_IEEE AXIS_PTS_X 1 FLOAT32_IEEE INDEX_INCR DIRECT /end RECORD_LAYOUT
/begin RECORD_LAYOUT Lookup2D_FLOAT64_IEEE FNC_VALUES 1 FLOAT64_IEEE COLUMN_DIR DIRECT /end RECORD_LAYOUT
/begin RECORD_LAYOUT Lookup2D_X_FLOAT64_IEEE AXIS_PTS_X 1 FLOAT64_IEEE INDEX_INCR DIRECT /end RECORD_LAYOUT
/begin CHARACTERISTIC ErrorSumMax1 "" VALUE @MemoryAddress@ErrorSumMax1@ Scalar_FLOAT64_IEEE 0 VCU_CS75_12_27_test_log_CM_double -1.7E+308 1.7E+308 /end CHARACTERISTIC
/begin CHARACTERISTIC ErrorSumMax2 "" VALUE @MemoryAddress@ErrorSumMax2@ Scalar_FLOAT64_IEEE 0 VCU_CS75_12_27_test_log_CM_double -1.7E+308 1.7E+308 /end CHARACTERISTIC
/begin CHARACTERISTIC ErrorSumMax3 "" VALUE @MemoryAddress@ErrorSumMax3@ Scalar_FLOAT64_IEEE 0 VCU_CS75_12_27_test_log_CM_double -1.7E+308 1.7E+308 /end CHARACTERISTIC
/begin CHARACTERISTIC I1 "" VALUE @MemoryAddress@I1@ Scalar_FLOAT64_IEEE 0 VCU_CS75_12_27_test_log_CM_double -1.7E+308 1.7E+308 /end CHARACTERISTIC
/begin CHARACTERISTIC I2 "" VALUE @MemoryAddress@I2@ Scalar_FLOAT64_IEEE 0 VCU_CS75_12_27_test_log_CM_double -1.7E+308 1.7E+308 /end CHARACTERISTIC
/begin CHARACTERISTIC I3 "" VALUE @MemoryAddress@I3@ Scalar_FLOAT64_IEEE 0 VCU_CS75_12_27_test_log_CM_double -1.7E+308 1.7E+308 /end CHARACTERISTIC
/begin CHARACTERISTIC LDW "" VALUE @MemoryAddress@LDW@ Scalar_FLOAT64_IEEE 0 VCU_CS75_12_27_test_log_CM_double -1.7E+308 1.7E+308 /end CHARACTERISTIC
/begin CHARACTERISTIC Log_ErrorSumMax1 "" VALUE @MemoryAddress@Log_ErrorSumMax1@ Scalar_FLOAT64_IEEE 0 VCU_CS75_12_27_test_log_CM_double -1.7E+308 1.7E+308 /end CHARACTERISTIC
/begin CHARACTERISTIC Log_ErrorSumMax2 "" VALUE @MemoryAddress@Log_ErrorSumMax2@ Scalar_FLOAT64_IEEE 0 VCU_CS75_12_27_test_log_CM_double -1.7E+308 1.7E+308 /end CHARACTERISTIC
/begin CHARACTERISTIC Log_I1 "" VALUE @MemoryAddress@Log_I1@ Scalar_FLOAT64_IEEE 0 VCU_CS75_12_27_test_log_CM_double -1.7E+308 1.7E+308 /end CHARACTERISTIC
/begin CHARACTERISTIC Log_I2 "" VALUE @MemoryAddress@Log_I2@ Scalar_FLOAT64_IEEE 0 VCU_CS75_12_27_test_log_CM_double -1.7E+308 1.7E+308 /end CHARACTERISTIC
/begin CHARACTERISTIC Log_P1 "" VALUE @MemoryAddress@Log_P1@ Scalar_FLOAT64_IEEE 0 VCU_CS75_12_27_test_log_CM_double -1.7E+308 1.7E+308 /end CHARACTERISTIC
/begin CHARACTERISTIC Log_P2 "" VALUE @MemoryAddress@Log_P2@ Scalar_FLOAT64_IEEE 0 VCU_CS75_12_27_test_log_CM_double -1.7E+308 1.7E+308 /end CHARACTERISTIC
/begin CHARACTERISTIC Log_Takeover "" VALUE @MemoryAddress@Log_Takeover@ Scalar_FLOAT64_IEEE 0 VCU_CS75_12_27_test_log_CM_double -1.7E+308 1.7E+308 /end CHARACTERISTIC
/begin CHARACTERISTIC P1 "" VALUE @MemoryAddress@P1@ Scalar_FLOAT64_IEEE 0 VCU_CS75_12_27_test_log_CM_double -1.7E+308 1.7E+308 /end CHARACTERISTIC
/begin CHARACTERISTIC P2 "" VALUE @MemoryAddress@P2@ Scalar_FLOAT64_IEEE 0 VCU_CS75_12_27_test_log_CM_double -1.7E+308 1.7E+308 /end CHARACTERISTIC
/begin CHARACTERISTIC P3 "" VALUE @MemoryAddress@P3@ Scalar_FLOAT64_IEEE 0 VCU_CS75_12_27_test_log_CM_double -1.7E+308 1.7E+308 /end CHARACTERISTIC
/begin CHARACTERISTIC RemoteAcc "" VALUE @MemoryAddress@RemoteAcc@ Scalar_FLOAT64_IEEE 0 VCU_CS75_12_27_test_log_CM_double -1.7E+308 1.7E+308 /end CHARACTERISTIC
/begin MEASUREMENT EMS_IndicatedRealTroq "" FLOAT64_IEEE VCU_CS75_12_27_test_log_CM_double 0 0 -1.7E+308 1.7E+308 ECU_ADDRESS @MemoryAddress@EMS_IndicatedRealTroq@ /end MEASUREMENT
/begin MEASUREMENT EMS_FrictionalTroq "" FLOAT64_IEEE VCU_CS75_12_27_test_log_CM_double 0 0 -1.7E+308 1.7E+308 ECU_ADDRESS @MemoryAddress@EMS_FrictionalTroq@ /end MEASUREMENT
/begin MEASUREMENT EMS_TorqueConstant "" FLOAT64_IEEE VCU_CS75_12_27_test_log_CM_double 0 0 -1.7E+308 1.7E+308 ECU_ADDRESS @MemoryAddress@EMS_TorqueConstant@ /end MEASUREMENT
/begin MEASUREMENT EMS_FullLoadIndicatedTroq "" FLOAT64_IEEE VCU_CS75_12_27_test_log_CM_double 0 0 -1.7E+308 1.7E+308 ECU_ADDRESS @MemoryAddress@EMS_FullLoadIndicatedTroq@ /end MEASUREMENT
/begin MEASUREMENT SAS_SteeringAngle "" FLOAT64_IEEE VCU_CS75_12_27_test_log_CM_double 0 0 -1.7E+308 1.7E+308 ECU_ADDRESS @MemoryAddress@SAS_SteeringAngle@ /end MEASUREMENT
/begin MEASUREMENT EPB_RollingCounter_id256 "" FLOAT64_IEEE VCU_CS75_12_27_test_log_CM_double 0 0 -1.7E+308 1.7E+308 ECU_ADDRESS @MemoryAddress@EPB_RollingCounter_id256@ /end MEASUREMENT
/begin MEASUREMENT EMS_BrakePedalStatus "" FLOAT64_IEEE VCU_CS75_12_27_test_log_CM_double 0 0 -1.7E+308 1.7E+308 ECU_ADDRESS @MemoryAddress@EMS_BrakePedalStatus@ /end MEASUREMENT
/begin MEASUREMENT P6_Value "" FLOAT64_IEEE VCU_CS75_12_27_test_log_CM_double 0 0 -1.7E+308 1.7E+308 ECU_ADDRESS @MemoryAddress@P6_Value@ /end MEASUREMENT
/begin MEASUREMENT EPS_AvailabilityStatus "" FLOAT64_IEEE VCU_CS75_12_27_test_log_CM_double 0 0 -1.7E+308 1.7E+308 ECU_ADDRESS @MemoryAddress@EPS_AvailabilityStatus@ /end MEASUREMENT
/begin MEASUREMENT Server_CommunicationStatus "" FLOAT64_IEEE VCU_CS75_12_27_test_log_CM_double 0 0 -1.7E+308 1.7E+308 ECU_ADDRESS @MemoryAddress@Server_CommunicationStatus@ /end MEASUREMENT
/begin MEASUREMENT A1counter "" FLOAT64_IEEE VCU_CS75_12_27_test_log_CM_double 0 0 -1.7E+308 1.7E+308 ECU_ADDRESS @MemoryAddress@A1counter@ /end MEASUREMENT
/begin MEASUREMENT System_State "" FLOAT64_IEEE VCU_CS75_12_27_test_log_CM_double 0 0 -1.7E+308 1.7E+308 ECU_ADDRESS @MemoryAddress@System_State@ /end MEASUREMENT
/begin MEASUREMENT VehicleCommunicationStatus "" FLOAT64_IEEE VCU_CS75_12_27_test_log_CM_double 0 0 -1.7E+308 1.7E+308 ECU_ADDRESS @MemoryAddress@VehicleCommunicationStatus@ /end MEASUREMENT
/begin MEASUREMENT counter1 "" FLOAT64_IEEE VCU_CS75_12_27_test_log_CM_double 0 0 -1.7E+308 1.7E+308 ECU_ADDRESS @MemoryAddress@counter1@ /end MEASUREMENT
/begin MEASUREMENT VehicleFaultStatus "" FLOAT64_IEEE VCU_CS75_12_27_test_log_CM_double 0 0 -1.7E+308 1.7E+308 ECU_ADDRESS @MemoryAddress@VehicleFaultStatus@ /end MEASUREMENT
/begin MEASUREMENT counter3 "" FLOAT64_IEEE VCU_CS75_12_27_test_log_CM_double 0 0 -1.7E+308 1.7E+308 ECU_ADDRESS @MemoryAddress@counter3@ /end MEASUREMENT
/begin MEASUREMENT ACC_TrqEnable "" FLOAT64_IEEE VCU_CS75_12_27_test_log_CM_double 0 0 -1.7E+308 1.7E+308 ECU_ADDRESS @MemoryAddress@ACC_TrqEnable@ /end MEASUREMENT
/begin MEASUREMENT ACC_RollingCounter_id2E5 "" FLOAT64_IEEE VCU_CS75_12_27_test_log_CM_double 0 0 -1.7E+308 1.7E+308 ECU_ADDRESS @MemoryAddress@ACC_RollingCounter_id2E5@ /end MEASUREMENT
/begin MEASUREMENT ACC_RollingCounter_id2E4 "" FLOAT64_IEEE VCU_CS75_12_27_test_log_CM_double 0 0 -1.7E+308 1.7E+308 ECU_ADDRESS @MemoryAddress@ACC_RollingCounter_id2E4@ /end MEASUREMENT
/begin MEASUREMENT ACC_ACCTargetAcceleration "" FLOAT64_IEEE VCU_CS75_12_27_test_log_CM_double 0 0 -1.7E+308 1.7E+308 ECU_ADDRESS @MemoryAddress@ACC_ACCTargetAcceleration@ /end MEASUREMENT
/begin MEASUREMENT ACC_Driveoff_Request "" FLOAT64_IEEE VCU_CS75_12_27_test_log_CM_double 0 0 -1.7E+308 1.7E+308 ECU_ADDRESS @MemoryAddress@ACC_Driveoff_Request@ /end MEASUREMENT
/begin MEASUREMENT ACC_CDDAxEnable "" FLOAT64_IEEE VCU_CS75_12_27_test_log_CM_double 0 0 -1.7E+308 1.7E+308 ECU_ADDRESS @MemoryAddress@ACC_CDDAxEnable@ /end MEASUREMENT
/begin MEASUREMENT mubiao_zhuanjiao "" FLOAT64_IEEE VCU_CS75_12_27_test_log_CM_double 0 0 -1.7E+308 1.7E+308 ECU_ADDRESS @MemoryAddress@mubiao_zhuanjiao@ /end MEASUREMENT
/begin MEASUREMENT LAS_LKSStatus "" FLOAT64_IEEE VCU_CS75_12_27_test_log_CM_double 0 0 -1.7E+308 1.7E+308 ECU_ADDRESS @MemoryAddress@LAS_LKSStatus@ /end MEASUREMENT
/begin MEASUREMENT LAS_RollingCounter "" FLOAT64_IEEE VCU_CS75_12_27_test_log_CM_double 0 0 -1.7E+308 1.7E+308 ECU_ADDRESS @MemoryAddress@LAS_RollingCounter@ /end MEASUREMENT
/begin MEASUREMENT PID_SteeringOut "" FLOAT64_IEEE VCU_CS75_12_27_test_log_CM_double 0 0 -1.7E+308 1.7E+308 ECU_ADDRESS @MemoryAddress@PID_SteeringOut@ /end MEASUREMENT
/begin MEASUREMENT Error "" FLOAT64_IEEE VCU_CS75_12_27_test_log_CM_double 0 0 -1.7E+308 1.7E+308 ECU_ADDRESS @MemoryAddress@Error@ /end MEASUREMENT
/begin MEASUREMENT ErrorSum "" FLOAT64_IEEE VCU_CS75_12_27_test_log_CM_double 0 0 -1.7E+308 1.7E+308 ECU_ADDRESS @MemoryAddress@ErrorSum@ /end MEASUREMENT
/begin MEASUREMENT LAS_LDWVibrationWarning "" FLOAT64_IEEE VCU_CS75_12_27_test_log_CM_double 0 0 -1.7E+308 1.7E+308 ECU_ADDRESS @MemoryAddress@LAS_LDWVibrationWarning@ /end MEASUREMENT
/begin MEASUREMENT LAS_LDWStatus "" FLOAT64_IEEE VCU_CS75_12_27_test_log_CM_double 0 0 -1.7E+308 1.7E+308 ECU_ADDRESS @MemoryAddress@LAS_LDWStatus@ /end MEASUREMENT
/begin MEASUREMENT Vx_out "" FLOAT32_IEEE VCU_CS75_12_27_test_log_CM_single 0 0 -3.4E+38 3.4E+38 ECU_ADDRESS @MemoryAddress@Vx_out@ /end MEASUREMENT
/begin MEASUREMENT mission_out "" FLOAT32_IEEE VCU_CS75_12_27_test_log_CM_single 0 0 -3.4E+38 3.4E+38 ECU_ADDRESS @MemoryAddress@mission_out@ /end MEASUREMENT
/begin MEASUREMENT SCS_out "" FLOAT32_IEEE VCU_CS75_12_27_test_log_CM_single 0 0 -3.4E+38 3.4E+38 ECU_ADDRESS @MemoryAddress@SCS_out@ /end MEASUREMENT
/begin MEASUREMENT finish_out "" FLOAT32_IEEE VCU_CS75_12_27_test_log_CM_single 0 0 -3.4E+38 3.4E+38 ECU_ADDRESS @MemoryAddress@finish_out@ /end MEASUREMENT
/begin MEASUREMENT tap_out "" FLOAT32_IEEE VCU_CS75_12_27_test_log_CM_single 0 0 -3.4E+38 3.4E+38 ECU_ADDRESS @MemoryAddress@tap_out@ /end MEASUREMENT
/begin MEASUREMENT cones_count_all_out "" FLOAT32_IEEE VCU_CS75_12_27_test_log_CM_single 0 0 -3.4E+38 3.4E+38 ECU_ADDRESS @MemoryAddress@cones_count_all_out@ /end MEASUREMENT
/begin MEASUREMENT cones_count_actual_out "" FLOAT32_IEEE VCU_CS75_12_27_test_log_CM_single 0 0 -3.4E+38 3.4E+38 ECU_ADDRESS @MemoryAddress@cones_count_actual_out@ /end MEASUREMENT
/begin COMPU_METHOD /* Name of CompuMethod */ VCU_CS75_12_27_test_log_CM_double "Q = V" /* Conversion Type */ RAT_FUNC /* Format */ "%15.10" /* Units */ "" /* Coefficients */ COEFFS 0 1 0 0 0 1 /end COMPU_METHOD
/begin COMPU_METHOD /* Name of CompuMethod */ VCU_CS75_12_27_test_log_CM_single "Q = V" /* Conversion Type */ RAT_FUNC /* Format */ "%8.6" /* Units */ "" /* Coefficients */ COEFFS 0 1 0 0 0 1 /end COMPU_METHOD
/begin GROUP VCU_CS75_12_27_test_log "VCU_CS75_12_27_test_log" /* Root */ ROOT /begin SUB_GROUP Root___CS75_____20ms__ /end SUB_GROUP
 /begin REF_MEASUREMENT SCS_out Vx_out cones_count_actual_out cones_count_all_out finish_out mission_out tap_out /end REF_MEASUREMENT
/end GROUP
/begin GROUP Root___CS75_____20ms__ "VCU_CS75_12_27_test_log/长安CS75底盘程序，20ms一次" /begin SUB_GROUP S2_APP S2_Input S2_Output /end SUB_GROUP /end GROUP
/begin GROUP S2_APP "VCU_CS75_12_27_test_log/长安CS75底盘程序，20ms一次/APP" /begin SUB_GROUP S24_Controller S24_Monitor S24_System_State_Manager /end SUB_GROUP /end GROUP
/begin GROUP S2_Input "VCU_CS75_12_27_test_log/长安CS75底盘程序，20ms一次/Input" /begin SUB_GROUP S25_ADC_Input S25_CAN0_Rx S25_CAN1_Rx /end SUB_GROUP /end GROUP
/begin GROUP S2_Output "VCU_CS75_12_27_test_log/长安CS75底盘程序，20ms一次/Output" /begin SUB_GROUP S26_CAN0_Tx /end SUB_GROUP /end GROUP
/begin GROUP S24_Controller "VCU_CS75_12_27_test_log/长安CS75底盘程序，20ms一次/APP/Controller" /begin SUB_GROUP S27_Accesories S27_Lateral S27_Longitudinal /end SUB_GROUP /end GROUP
/begin GROUP S24_Monitor "VCU_CS75_12_27_test_log/长安CS75底盘程序，20ms一次/APP/Monitor" /begin SUB_GROUP S28_Server_Status S28_Vehicle_Status /end SUB_GROUP /end GROUP
/begin GROUP S24_System_State_Manager "VCU_CS75_12_27_test_log/长安CS75底盘程序，20ms一次/APP/System_State_Manager" /begin REF_MEASUREMENT System_State /end REF_MEASUREMENT /end GROUP
/begin GROUP S25_ADC_Input "VCU_CS75_12_27_test_log/长安CS75底盘程序，20ms一次/Input/ADC_Input" /begin REF_MEASUREMENT P6_Value /end REF_MEASUREMENT /end GROUP
/begin GROUP S25_CAN0_Rx "VCU_CS75_12_27_test_log/长安CS75底盘程序，20ms一次/Input/CAN0_Rx" /begin SUB_GROUP S62_a1_211 /end SUB_GROUP /end GROUP
/begin GROUP S25_CAN1_Rx "VCU_CS75_12_27_test_log/长安CS75底盘程序，20ms一次/Input/CAN1_Rx" /begin SUB_GROUP S63_EMS_255 S63_EPB_256 S63_SAS_108 /end SUB_GROUP /end GROUP
/begin GROUP S26_CAN0_Tx "VCU_CS75_12_27_test_log/长安CS75底盘程序，20ms一次/Output/CAN0_Tx" /begin SUB_GROUP S694_to511 /end SUB_GROUP /end GROUP
/begin GROUP S27_Accesories "VCU_CS75_12_27_test_log/长安CS75底盘程序，20ms一次/APP/Controller/Accesories" /begin REF_CHARACTERISTIC LDW /end REF_CHARACTERISTIC /begin REF_MEASUREMENT LAS_LDWStatus LAS_LDWVibrationWarning /end REF_MEASUREMENT /end GROUP
/begin GROUP S27_Lateral "VCU_CS75_12_27_test_log/长安CS75底盘程序，20ms一次/APP/Controller/Lateral" /begin REF_CHARACTERISTIC ErrorSumMax1 ErrorSumMax2 ErrorSumMax3 I1 I2 I3 P1 P2 P3 /end REF_CHARACTERISTIC
 /begin REF_MEASUREMENT Error ErrorSum LAS_LKSStatus LAS_RollingCounter PID_SteeringOut mubiao_zhuanjiao /end REF_MEASUREMENT
/end GROUP
/begin GROUP S27_Longitudinal "VCU_CS75_12_27_test_log/长安CS75底盘程序，20ms一次/APP/Controller/Longitudinal"
 /begin REF_CHARACTERISTIC Log_ErrorSumMax1 Log_ErrorSumMax2 Log_I1 Log_I2 Log_P1 Log_P2 /end REF_CHARACTERISTIC
 /begin REF_MEASUREMENT ACC_ACCTargetAcceleration ACC_CDDAxEnable ACC_Driveoff_Request ACC_RollingCounter_id2E4 ACC_RollingCounter_id2E5 ACC_TrqEnable /end REF_MEASUREMENT
/end GROUP
/begin GROUP S28_Server_Status "VCU_CS75_12_27_test_log/长安CS75底盘程序，20ms一次/APP/Monitor/Server_Status" /begin REF_MEASUREMENT A1counter Server_CommunicationStatus counter3 /end REF_MEASUREMENT /end GROUP
/begin GROUP S28_Vehicle_Status "VCU_CS75_12_27_test_log/长安CS75底盘程序，20ms一次/APP/Monitor/Vehicle_Status"
 /begin REF_MEASUREMENT EPS_AvailabilityStatus VehicleCommunicationStatus VehicleFaultStatus counter1 /end REF_MEASUREMENT
/end GROUP
/begin GROUP S62_a1_211 "VCU_CS75_12_27_test_log/长安CS75底盘程序，20ms一次/Input/CAN0_Rx/a1_211" /begin SUB_GROUP S67_ReceiveMessages /end SUB_GROUP /end GROUP
/begin GROUP S63_EMS_255 "VCU_CS75_12_27_test_log/长安CS75底盘程序，20ms一次/Input/CAN1_Rx/EMS_255" /begin SUB_GROUP S86_ReceiveMessages /end SUB_GROUP /end GROUP
/begin GROUP S63_EPB_256 "VCU_CS75_12_27_test_log/长安CS75底盘程序，20ms一次/Input/CAN1_Rx/EPB_256" /begin SUB_GROUP S89_ReceiveMessages /end SUB_GROUP /end GROUP
/begin GROUP S63_SAS_108 "VCU_CS75_12_27_test_log/长安CS75底盘程序，20ms一次/Input/CAN1_Rx/SAS_108" /begin SUB_GROUP S104_ReceiveMessages /end SUB_GROUP /end GROUP
/begin GROUP S694_to511 "VCU_CS75_12_27_test_log/长安CS75底盘程序，20ms一次/Output/CAN0_Tx/to511"
 /begin REF_MEASUREMENT EMS_FrictionalTroq EMS_FullLoadIndicatedTroq EMS_IndicatedRealTroq EMS_TorqueConstant /end REF_MEASUREMENT
/end GROUP
/begin GROUP S67_ReceiveMessages "VCU_CS75_12_27_test_log/长安CS75底盘程序，20ms一次/Input/CAN0_Rx/a1_211/ReceiveMessages" /begin SUB_GROUP S68_Subsystem /end SUB_GROUP /end GROUP
/begin GROUP S86_ReceiveMessages "VCU_CS75_12_27_test_log/长安CS75底盘程序，20ms一次/Input/CAN1_Rx/EMS_255/ReceiveMessages" /begin SUB_GROUP S167_Subsystem /end SUB_GROUP /end GROUP
/begin GROUP S89_ReceiveMessages "VCU_CS75_12_27_test_log/长安CS75底盘程序，20ms一次/Input/CAN1_Rx/EPB_256/ReceiveMessages" /begin SUB_GROUP S188_Subsystem /end SUB_GROUP /end GROUP
/begin GROUP S104_ReceiveMessages "VCU_CS75_12_27_test_log/长安CS75底盘程序，20ms一次/Input/CAN1_Rx/SAS_108/ReceiveMessages" /begin SUB_GROUP S367_Subsystem /end SUB_GROUP /end GROUP
/begin GROUP S68_Subsystem "VCU_CS75_12_27_test_log/长安CS75底盘程序，20ms一次/Input/CAN0_Rx/a1_211/ReceiveMessages/Subsystem" /begin REF_CHARACTERISTIC Log_Takeover RemoteAcc /end REF_CHARACTERISTIC /end GROUP
/begin GROUP S167_Subsystem "VCU_CS75_12_27_test_log/长安CS75底盘程序，20ms一次/Input/CAN1_Rx/EMS_255/ReceiveMessages/Subsystem" /begin SUB_GROUP S168_EMS /end SUB_GROUP /end GROUP
/begin GROUP S188_Subsystem "VCU_CS75_12_27_test_log/长安CS75底盘程序，20ms一次/Input/CAN1_Rx/EPB_256/ReceiveMessages/Subsystem" /begin SUB_GROUP S189_EPB /end SUB_GROUP /end GROUP
/begin GROUP S367_Subsystem "VCU_CS75_12_27_test_log/长安CS75底盘程序，20ms一次/Input/CAN1_Rx/SAS_108/ReceiveMessages/Subsystem" /begin SUB_GROUP S368_SAS_2 /end SUB_GROUP /end GROUP
/begin GROUP S168_EMS "VCU_CS75_12_27_test_log/长安CS75底盘程序，20ms一次/Input/CAN1_Rx/EMS_255/ReceiveMessages/Subsystem/EMS" /begin REF_MEASUREMENT EMS_BrakePedalStatus /end REF_MEASUREMENT /end GROUP
/begin GROUP S189_EPB "VCU_CS75_12_27_test_log/长安CS75底盘程序，20ms一次/Input/CAN1_Rx/EPB_256/ReceiveMessages/Subsystem/EPB" /begin REF_MEASUREMENT EPB_RollingCounter_id256 /end REF_MEASUREMENT /end GROUP
/begin GROUP S368_SAS_2 "VCU_CS75_12_27_test_log/长安CS75底盘程序，20ms一次/Input/CAN1_Rx/SAS_108/ReceiveMessages/Subsystem/SAS_2" /begin REF_MEASUREMENT SAS_SteeringAngle /end REF_MEASUREMENT /end GROUP
/end MODULE
/end PROJECT
/* (add any file trailer comments here) */
/* EOF VCU_CS75_12_27_test_log.a2l */
