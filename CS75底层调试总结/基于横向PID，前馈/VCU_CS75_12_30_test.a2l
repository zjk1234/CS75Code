/******************************************************************************
* ASAP2 file: VCU_CS75_12_30_test.a2l
* Code generation for model "VCU_CS75_12_30_test".
* Model version : 1.2790
* Simulink Coder version : 8.6 (R2014a) 27-Dec-2013
* C source code generated on : Wed Mar 31 16:43:53 2021
* Target selection: ec5744.tlc
* Embedded hardware selection: Freescale MPC5500
* Code generation objectives: Unspecified
* Validation result: Not run
* (add additional file header information here)
******************************************************************************/ ASAP2_VERSION 1 31
/* Version 1.31 */
/begin PROJECT ECUCoderProject "ECUCoder Project"
/begin HEADER "Header Comments go here" /end HEADER
/begin MODULE ModuleName "Module Comment Goes Here"
/begin MOD_PAR "MOD PAR Comment Goes Here" /end MOD_PAR
/begin MOD_COMMON "Mod Common Comment Here" BYTE_ORDER MSB_FIRST /end MOD_COMMON
/begin RECORD_LAYOUT Scalar_BOOLEAN FNC_VALUES 1 UBYTE COLUMN_DIR DIRECT /end RECORD_LAYOUT
/begin RECORD_LAYOUT Scalar_UBYTE FNC_VALUES 1 UBYTE COLUMN_DIR DIRECT /end RECORD_LAYOUT
/begin RECORD_LAYOUT Scalar_BYTE FNC_VALUES 1 SBYTE COLUMN_DIR DIRECT /end RECORD_LAYOUT
/begin RECORD_LAYOUT Scalar_UWORD FNC_VALUES 1 UWORD COLUMN_DIR DIRECT /end RECORD_LAYOUT
/begin RECORD_LAYOUT Scalar_SWORD FNC_VALUES 1 SWORD COLUMN_DIR DIRECT /end RECORD_LAYOUT
/begin RECORD_LAYOUT Scalar_ULONG FNC_VALUES 1 ULONG COLUMN_DIR DIRECT /end RECORD_LAYOUT
/begin RECORD_LAYOUT Scalar_LONG FNC_VALUES 1 SLONG COLUMN_DIR DIRECT /end RECORD_LAYOUT
/begin RECORD_LAYOUT Scalar_FLOAT32_IEEE FNC_VALUES 1 FLOAT32_IEEE COLUMN_DIR DIRECT /end RECORD_LAYOUT
/begin RECORD_LAYOUT Scalar_FLOAT64_IEEE FNC_VALUES 1 FLOAT64_IEEE COLUMN_DIR DIRECT /end RECORD_LAYOUT
/begin RECORD_LAYOUT Lookup1D_BOOLEAN FNC_VALUES 1 UBYTE COLUMN_DIR DIRECT /end RECORD_LAYOUT
/begin RECORD_LAYOUT Lookup1D_X_BOOLEAN AXIS_PTS_X 1 UBYTE INDEX_INCR DIRECT /end RECORD_LAYOUT
/begin RECORD_LAYOUT Lookup1D_BYTE FNC_VALUES 1 SBYTE COLUMN_DIR DIRECT /end RECORD_LAYOUT
/begin RECORD_LAYOUT Lookup1D_X_BYTE AXIS_PTS_X 1 SBYTE INDEX_INCR DIRECT /end RECORD_LAYOUT
/begin RECORD_LAYOUT Lookup1D_UBYTE FNC_VALUES 1 UBYTE COLUMN_DIR DIRECT /end RECORD_LAYOUT
/begin RECORD_LAYOUT Lookup1D_X_UBYTE AXIS_PTS_X 1 UBYTE INDEX_INCR DIRECT /end RECORD_LAYOUT
/begin RECORD_LAYOUT Lookup1D_UWORD FNC_VALUES 1 UWORD COLUMN_DIR DIRECT /end RECORD_LAYOUT
/begin RECORD_LAYOUT Lookup1D_X_UWORD AXIS_PTS_X 1 UWORD INDEX_INCR DIRECT /end RECORD_LAYOUT
/begin RECORD_LAYOUT Lookup1D_WORD FNC_VALUES 1 SWORD COLUMN_DIR DIRECT /end RECORD_LAYOUT
/begin RECORD_LAYOUT Lookup1D_X_WORD AXIS_PTS_X 1 SWORD INDEX_INCR DIRECT /end RECORD_LAYOUT
/begin RECORD_LAYOUT Lookup1D_ULONG FNC_VALUES 1 ULONG COLUMN_DIR DIRECT /end RECORD_LAYOUT
/begin RECORD_LAYOUT Lookup1D_X_ULONG AXIS_PTS_X 1 ULONG INDEX_INCR DIRECT /end RECORD_LAYOUT
/begin RECORD_LAYOUT Lookup1D_SLONG FNC_VALUES 1 SLONG COLUMN_DIR DIRECT /end RECORD_LAYOUT
/begin RECORD_LAYOUT Lookup1D_X_LONG AXIS_PTS_X 1 SLONG INDEX_INCR DIRECT /end RECORD_LAYOUT
/begin RECORD_LAYOUT Lookup1D_FLOAT32_IEEE FNC_VALUES 1 FLOAT32_IEEE COLUMN_DIR DIRECT /end RECORD_LAYOUT
/begin RECORD_LAYOUT Lookup1D_X_FLOAT32_IEEE AXIS_PTS_X 1 FLOAT32_IEEE INDEX_INCR DIRECT /end RECORD_LAYOUT
/begin RECORD_LAYOUT Lookup1D_FLOAT64_IEEE FNC_VALUES 1 FLOAT64_IEEE COLUMN_DIR DIRECT /end RECORD_LAYOUT
/begin RECORD_LAYOUT Lookup1D_X_FLOAT64_IEEE AXIS_PTS_X 1 FLOAT64_IEEE INDEX_INCR DIRECT /end RECORD_LAYOUT
/begin RECORD_LAYOUT Lookup2D_BOOLEAN FNC_VALUES 1 UBYTE COLUMN_DIR DIRECT /end RECORD_LAYOUT
/begin RECORD_LAYOUT Lookup2D_X_BOOLEAN AXIS_PTS_X 1 UBYTE INDEX_INCR DIRECT /end RECORD_LAYOUT
/begin RECORD_LAYOUT Lookup2D_UBYTE FNC_VALUES 1 UBYTE COLUMN_DIR DIRECT /end RECORD_LAYOUT
/begin RECORD_LAYOUT Lookup2D_X_UBYTE AXIS_PTS_X 1 UBYTE INDEX_INCR DIRECT /end RECORD_LAYOUT
/begin RECORD_LAYOUT Lookup2D_BYTE FNC_VALUES 1 SBYTE COLUMN_DIR DIRECT /end RECORD_LAYOUT
/begin RECORD_LAYOUT Lookup2D_X_BYTE AXIS_PTS_X 1 SBYTE INDEX_INCR DIRECT /end RECORD_LAYOUT
/begin RECORD_LAYOUT Lookup2D_UWORD FNC_VALUES 1 UWORD COLUMN_DIR DIRECT /end RECORD_LAYOUT
/begin RECORD_LAYOUT Lookup2D_X_UWORD AXIS_PTS_X 1 UWORD INDEX_INCR DIRECT /end RECORD_LAYOUT
/begin RECORD_LAYOUT Lookup2D_WORD FNC_VALUES 1 SWORD COLUMN_DIR DIRECT /end RECORD_LAYOUT
/begin RECORD_LAYOUT Lookup2D_X_WORD AXIS_PTS_X 1 SWORD INDEX_INCR DIRECT /end RECORD_LAYOUT
/begin RECORD_LAYOUT Lookup2D_ULONG FNC_VALUES 1 ULONG COLUMN_DIR DIRECT /end RECORD_LAYOUT
/begin RECORD_LAYOUT Lookup2D_X_ULONG AXIS_PTS_X 1 ULONG INDEX_INCR DIRECT /end RECORD_LAYOUT
/begin RECORD_LAYOUT Lookup2D_LONG FNC_VALUES 1 SLONG COLUMN_DIR DIRECT /end RECORD_LAYOUT
/begin RECORD_LAYOUT Lookup2D_X_LONG AXIS_PTS_X 1 SLONG INDEX_INCR DIRECT /end RECORD_LAYOUT
/begin RECORD_LAYOUT Lookup2D_FLOAT32_IEEE FNC_VALUES 1 FLOAT32_IEEE COLUMN_DIR DIRECT /end RECORD_LAYOUT
/begin RECORD_LAYOUT Lookup2D_X_FLOAT32_IEEE AXIS_PTS_X 1 FLOAT32_IEEE INDEX_INCR DIRECT /end RECORD_LAYOUT
/begin RECORD_LAYOUT Lookup2D_FLOAT64_IEEE FNC_VALUES 1 FLOAT64_IEEE COLUMN_DIR DIRECT /end RECORD_LAYOUT
/begin RECORD_LAYOUT Lookup2D_X_FLOAT64_IEEE AXIS_PTS_X 1 FLOAT64_IEEE INDEX_INCR DIRECT /end RECORD_LAYOUT
/begin CHARACTERISTIC D1 "" VALUE 0x400012a0 Scalar_FLOAT64_IEEE 0 VCU_CS75_12_30_test_CM_double -1.7E+308 1.7E+308 /end CHARACTERISTIC
/begin CHARACTERISTIC D2 "" VALUE 0x400012a8 Scalar_FLOAT64_IEEE 0 VCU_CS75_12_30_test_CM_double -1.7E+308 1.7E+308 /end CHARACTERISTIC
/begin CHARACTERISTIC D3 "" VALUE 0x400012b0 Scalar_FLOAT64_IEEE 0 VCU_CS75_12_30_test_CM_double -1.7E+308 1.7E+308 /end CHARACTERISTIC
/begin CHARACTERISTIC ErrorLimit "" VALUE 0x40001100 Scalar_FLOAT64_IEEE 0 VCU_CS75_12_30_test_CM_double -1.7E+308 1.7E+308 /end CHARACTERISTIC
/begin CHARACTERISTIC ErrorSumMax1 "" VALUE 0x40001108 Scalar_FLOAT64_IEEE 0 VCU_CS75_12_30_test_CM_double -1.7E+308 1.7E+308 /end CHARACTERISTIC
/begin CHARACTERISTIC ErrorSumMax2 "" VALUE 0x40001110 Scalar_FLOAT64_IEEE 0 VCU_CS75_12_30_test_CM_double -1.7E+308 1.7E+308 /end CHARACTERISTIC
/begin CHARACTERISTIC ErrorSumMax3 "" VALUE 0x40001118 Scalar_FLOAT64_IEEE 0 VCU_CS75_12_30_test_CM_double -1.7E+308 1.7E+308 /end CHARACTERISTIC
/begin CHARACTERISTIC I1 "" VALUE 0x40001120 Scalar_FLOAT64_IEEE 0 VCU_CS75_12_30_test_CM_double -1.7E+308 1.7E+308 /end CHARACTERISTIC
/begin CHARACTERISTIC I2 "" VALUE 0x40001128 Scalar_FLOAT64_IEEE 0 VCU_CS75_12_30_test_CM_double -1.7E+308 1.7E+308 /end CHARACTERISTIC
/begin CHARACTERISTIC I3 "" VALUE 0x40001130 Scalar_FLOAT64_IEEE 0 VCU_CS75_12_30_test_CM_double -1.7E+308 1.7E+308 /end CHARACTERISTIC
/begin CHARACTERISTIC LDW "" VALUE 0x400012b8 Scalar_FLOAT64_IEEE 0 VCU_CS75_12_30_test_CM_double -1.7E+308 1.7E+308 /end CHARACTERISTIC
/begin CHARACTERISTIC Limit1 "" VALUE 0x40001138 Scalar_FLOAT64_IEEE 0 VCU_CS75_12_30_test_CM_double -1.7E+308 1.7E+308 /end CHARACTERISTIC
/begin CHARACTERISTIC Limit2 "" VALUE 0x40001140 Scalar_FLOAT64_IEEE 0 VCU_CS75_12_30_test_CM_double -1.7E+308 1.7E+308 /end CHARACTERISTIC
/begin CHARACTERISTIC P1 "" VALUE 0x40001148 Scalar_FLOAT64_IEEE 0 VCU_CS75_12_30_test_CM_double -1.7E+308 1.7E+308 /end CHARACTERISTIC
/begin CHARACTERISTIC P2 "" VALUE 0x40001150 Scalar_FLOAT64_IEEE 0 VCU_CS75_12_30_test_CM_double -1.7E+308 1.7E+308 /end CHARACTERISTIC
/begin CHARACTERISTIC P3 "" VALUE 0x40001158 Scalar_FLOAT64_IEEE 0 VCU_CS75_12_30_test_CM_double -1.7E+308 1.7E+308 /end CHARACTERISTIC
/begin CHARACTERISTIC T_buchang "" VALUE 0x40001160 Scalar_FLOAT64_IEEE 0 VCU_CS75_12_30_test_CM_double -1.7E+308 1.7E+308 /end CHARACTERISTIC
/begin MEASUREMENT EMS_IndicatedRealTroq "" FLOAT64_IEEE VCU_CS75_12_30_test_CM_double 0 0 -1.7E+308 1.7E+308 ECU_ADDRESS 0x400011f0 /end MEASUREMENT
/begin MEASUREMENT EMS_FrictionalTroq "" FLOAT64_IEEE VCU_CS75_12_30_test_CM_double 0 0 -1.7E+308 1.7E+308 ECU_ADDRESS 0x40001220 /end MEASUREMENT
/begin MEASUREMENT EMS_TorqueConstant "" FLOAT64_IEEE VCU_CS75_12_30_test_CM_double 0 0 -1.7E+308 1.7E+308 ECU_ADDRESS 0x40001238 /end MEASUREMENT
/begin MEASUREMENT EMS_FullLoadIndicatedTroq "" FLOAT64_IEEE VCU_CS75_12_30_test_CM_double 0 0 -1.7E+308 1.7E+308 ECU_ADDRESS 0x40001190 /end MEASUREMENT
/begin MEASUREMENT SAS_SteeringAngle "" FLOAT64_IEEE VCU_CS75_12_30_test_CM_double 0 0 -1.7E+308 1.7E+308 ECU_ADDRESS 0x40001218 /end MEASUREMENT
/begin MEASUREMENT EPB_RollingCounter_id256 "" FLOAT64_IEEE VCU_CS75_12_30_test_CM_double 0 0 -1.7E+308 1.7E+308 ECU_ADDRESS 0x40001288 /end MEASUREMENT
/begin MEASUREMENT EMS_BrakePedalStatus "" FLOAT64_IEEE VCU_CS75_12_30_test_CM_double 0 0 -1.7E+308 1.7E+308 ECU_ADDRESS 0x40001250 /end MEASUREMENT
/begin MEASUREMENT P6_Value "" FLOAT64_IEEE VCU_CS75_12_30_test_CM_double 0 0 -1.7E+308 1.7E+308 ECU_ADDRESS 0x400011f8 /end MEASUREMENT
/begin MEASUREMENT EPS_AvailabilityStatus "" FLOAT64_IEEE VCU_CS75_12_30_test_CM_double 0 0 -1.7E+308 1.7E+308 ECU_ADDRESS 0x40001280 /end MEASUREMENT
/begin MEASUREMENT Server_CommunicationStatus "" FLOAT64_IEEE VCU_CS75_12_30_test_CM_double 0 0 -1.7E+308 1.7E+308 ECU_ADDRESS 0x400011d8 /end MEASUREMENT
/begin MEASUREMENT A1counter "" FLOAT64_IEEE VCU_CS75_12_30_test_CM_double 0 0 -1.7E+308 1.7E+308 ECU_ADDRESS 0x40001228 /end MEASUREMENT
/begin MEASUREMENT System_State "" FLOAT64_IEEE VCU_CS75_12_30_test_CM_double 0 0 -1.7E+308 1.7E+308 ECU_ADDRESS 0x40001258 /end MEASUREMENT
/begin MEASUREMENT VehicleCommunicationStatus "" FLOAT64_IEEE VCU_CS75_12_30_test_CM_double 0 0 -1.7E+308 1.7E+308 ECU_ADDRESS 0x400011e8 /end MEASUREMENT
/begin MEASUREMENT counter1 "" FLOAT64_IEEE VCU_CS75_12_30_test_CM_double 0 0 -1.7E+308 1.7E+308 ECU_ADDRESS 0x400011c8 /end MEASUREMENT
/begin MEASUREMENT VehicleFaultStatus "" FLOAT64_IEEE VCU_CS75_12_30_test_CM_double 0 0 -1.7E+308 1.7E+308 ECU_ADDRESS 0x40001210 /end MEASUREMENT
/begin MEASUREMENT counter3 "" FLOAT64_IEEE VCU_CS75_12_30_test_CM_double 0 0 -1.7E+308 1.7E+308 ECU_ADDRESS 0x40001180 /end MEASUREMENT
/begin MEASUREMENT ACC_TrqEnable "" FLOAT64_IEEE VCU_CS75_12_30_test_CM_double 0 0 -1.7E+308 1.7E+308 ECU_ADDRESS 0x40001260 /end MEASUREMENT
/begin MEASUREMENT ACC_AccTorqueReq "" FLOAT64_IEEE VCU_CS75_12_30_test_CM_double 0 0 -1.7E+308 1.7E+308 ECU_ADDRESS 0x40001178 /end MEASUREMENT
/begin MEASUREMENT ACC_RollingCounter_id2E5 "" FLOAT64_IEEE VCU_CS75_12_30_test_CM_double 0 0 -1.7E+308 1.7E+308 ECU_ADDRESS 0x40001208 /end MEASUREMENT
/begin MEASUREMENT ACC_RollingCounter_id2E4 "" FLOAT64_IEEE VCU_CS75_12_30_test_CM_double 0 0 -1.7E+308 1.7E+308 ECU_ADDRESS 0x40001290 /end MEASUREMENT
/begin MEASUREMENT ACC_ACCTargetAcceleration "" FLOAT64_IEEE VCU_CS75_12_30_test_CM_double 0 0 -1.7E+308 1.7E+308 ECU_ADDRESS 0x400011a0 /end MEASUREMENT
/begin MEASUREMENT ACC_Driveoff_Request "" FLOAT64_IEEE VCU_CS75_12_30_test_CM_double 0 0 -1.7E+308 1.7E+308 ECU_ADDRESS 0x40001268 /end MEASUREMENT
/begin MEASUREMENT ACC_CDDAxEnable "" FLOAT64_IEEE VCU_CS75_12_30_test_CM_double 0 0 -1.7E+308 1.7E+308 ECU_ADDRESS 0x400011b8 /end MEASUREMENT
/begin MEASUREMENT mubiao_zhuanjiao "" FLOAT64_IEEE VCU_CS75_12_30_test_CM_double 0 0 -1.7E+308 1.7E+308 ECU_ADDRESS 0x40001240 /end MEASUREMENT
/begin MEASUREMENT LAS_LKSStatus "" FLOAT64_IEEE VCU_CS75_12_30_test_CM_double 0 0 -1.7E+308 1.7E+308 ECU_ADDRESS 0x400011e0 /end MEASUREMENT
/begin MEASUREMENT LAS_RollingCounter "" FLOAT64_IEEE VCU_CS75_12_30_test_CM_double 0 0 -1.7E+308 1.7E+308 ECU_ADDRESS 0x40001200 /end MEASUREMENT
/begin MEASUREMENT PID_SteeringOut "" FLOAT64_IEEE VCU_CS75_12_30_test_CM_double 0 0 -1.7E+308 1.7E+308 ECU_ADDRESS 0x400011a8 /end MEASUREMENT
/begin MEASUREMENT Error "" FLOAT64_IEEE VCU_CS75_12_30_test_CM_double 0 0 -1.7E+308 1.7E+308 ECU_ADDRESS 0x40001248 /end MEASUREMENT
/begin MEASUREMENT ErrorSum "" FLOAT64_IEEE VCU_CS75_12_30_test_CM_double 0 0 -1.7E+308 1.7E+308 ECU_ADDRESS 0x40001198 /end MEASUREMENT
/begin MEASUREMENT LAS_LDWVibrationWarning "" FLOAT64_IEEE VCU_CS75_12_30_test_CM_double 0 0 -1.7E+308 1.7E+308 ECU_ADDRESS 0x40001230 /end MEASUREMENT
/begin MEASUREMENT LAS_LDWStatus "" FLOAT64_IEEE VCU_CS75_12_30_test_CM_double 0 0 -1.7E+308 1.7E+308 ECU_ADDRESS 0x400011b0 /end MEASUREMENT
/begin MEASUREMENT Vx_out "" FLOAT32_IEEE VCU_CS75_12_30_test_CM_single 0 0 -3.4E+38 3.4E+38 ECU_ADDRESS 0x40001278 /end MEASUREMENT
/begin MEASUREMENT mission_out "" FLOAT32_IEEE VCU_CS75_12_30_test_CM_single 0 0 -3.4E+38 3.4E+38 ECU_ADDRESS 0x400011c0 /end MEASUREMENT
/begin MEASUREMENT SCS_out "" FLOAT32_IEEE VCU_CS75_12_30_test_CM_single 0 0 -3.4E+38 3.4E+38 ECU_ADDRESS 0x40001188 /end MEASUREMENT
/begin MEASUREMENT finish_out "" FLOAT32_IEEE VCU_CS75_12_30_test_CM_single 0 0 -3.4E+38 3.4E+38 ECU_ADDRESS 0x400011d0 /end MEASUREMENT
/begin MEASUREMENT tap_out "" FLOAT32_IEEE VCU_CS75_12_30_test_CM_single 0 0 -3.4E+38 3.4E+38 ECU_ADDRESS 0x40001270 /end MEASUREMENT
/begin MEASUREMENT cones_count_all_out "" FLOAT32_IEEE VCU_CS75_12_30_test_CM_single 0 0 -3.4E+38 3.4E+38 ECU_ADDRESS 0x40001170 /end MEASUREMENT
/begin MEASUREMENT cones_count_actual_out "" FLOAT32_IEEE VCU_CS75_12_30_test_CM_single 0 0 -3.4E+38 3.4E+38 ECU_ADDRESS 0x40001274 /end MEASUREMENT
/begin COMPU_METHOD /* Name of CompuMethod */ VCU_CS75_12_30_test_CM_double "Q = V" /* Conversion Type */ RAT_FUNC /* Format */ "%15.10" /* Units */ "" /* Coefficients */ COEFFS 0 1 0 0 0 1 /end COMPU_METHOD
/begin COMPU_METHOD /* Name of CompuMethod */ VCU_CS75_12_30_test_CM_single "Q = V" /* Conversion Type */ RAT_FUNC /* Format */ "%8.6" /* Units */ "" /* Coefficients */ COEFFS 0 1 0 0 0 1 /end COMPU_METHOD
/begin GROUP VCU_CS75_12_30_test "VCU_CS75_12_30_test" /* Root */ ROOT /begin SUB_GROUP Root___CS75_____20ms__ /end SUB_GROUP
 /begin REF_MEASUREMENT SCS_out Vx_out cones_count_actual_out cones_count_all_out finish_out mission_out tap_out /end REF_MEASUREMENT
/end GROUP
/begin GROUP Root___CS75_____20ms__ "VCU_CS75_12_30_test/长安CS75底盘程序，20ms一次" /begin SUB_GROUP S2_APP S2_Input S2_Output /end SUB_GROUP /end GROUP
/begin GROUP S2_APP "VCU_CS75_12_30_test/长安CS75底盘程序，20ms一次/APP" /begin SUB_GROUP S24_Controller S24_Monitor S24_System_State_Manager /end SUB_GROUP /end GROUP
/begin GROUP S2_Input "VCU_CS75_12_30_test/长安CS75底盘程序，20ms一次/Input" /begin SUB_GROUP S25_ADC_Input S25_CAN1_Rx /end SUB_GROUP /end GROUP
/begin GROUP S2_Output "VCU_CS75_12_30_test/长安CS75底盘程序，20ms一次/Output" /begin SUB_GROUP S26_CAN0_Tx /end SUB_GROUP /end GROUP
/begin GROUP S24_Controller "VCU_CS75_12_30_test/长安CS75底盘程序，20ms一次/APP/Controller" /begin SUB_GROUP S27_Accesories S27_Lateral S27_Longitudinal /end SUB_GROUP /end GROUP
/begin GROUP S24_Monitor "VCU_CS75_12_30_test/长安CS75底盘程序，20ms一次/APP/Monitor" /begin SUB_GROUP S28_Server_Status S28_Vehicle_Status /end SUB_GROUP /end GROUP
/begin GROUP S24_System_State_Manager "VCU_CS75_12_30_test/长安CS75底盘程序，20ms一次/APP/System_State_Manager" /begin REF_MEASUREMENT System_State /end REF_MEASUREMENT /end GROUP
/begin GROUP S25_ADC_Input "VCU_CS75_12_30_test/长安CS75底盘程序，20ms一次/Input/ADC_Input" /begin REF_MEASUREMENT P6_Value /end REF_MEASUREMENT /end GROUP
/begin GROUP S25_CAN1_Rx "VCU_CS75_12_30_test/长安CS75底盘程序，20ms一次/Input/CAN1_Rx" /begin SUB_GROUP S62_EMS_255 S62_EPB_256 S62_SAS_108 /end SUB_GROUP /end GROUP
/begin GROUP S26_CAN0_Tx "VCU_CS75_12_30_test/长安CS75底盘程序，20ms一次/Output/CAN0_Tx" /begin SUB_GROUP S693_to511 /end SUB_GROUP /end GROUP
/begin GROUP S27_Accesories "VCU_CS75_12_30_test/长安CS75底盘程序，20ms一次/APP/Controller/Accesories" /begin REF_CHARACTERISTIC LDW /end REF_CHARACTERISTIC /begin REF_MEASUREMENT LAS_LDWStatus LAS_LDWVibrationWarning /end REF_MEASUREMENT /end GROUP
/begin GROUP S27_Lateral "VCU_CS75_12_30_test/长安CS75底盘程序，20ms一次/APP/Controller/Lateral"
 /begin REF_CHARACTERISTIC D1 D2 D3 ErrorLimit ErrorSumMax1 ErrorSumMax2 ErrorSumMax3 I1 I2 I3 Limit1 Limit2 P1 P2 P3 T_buchang /end REF_CHARACTERISTIC
 /begin REF_MEASUREMENT Error ErrorSum LAS_LKSStatus LAS_RollingCounter PID_SteeringOut mubiao_zhuanjiao /end REF_MEASUREMENT
/end GROUP
/begin GROUP S27_Longitudinal "VCU_CS75_12_30_test/长安CS75底盘程序，20ms一次/APP/Controller/Longitudinal"
 /begin REF_MEASUREMENT ACC_ACCTargetAcceleration ACC_AccTorqueReq ACC_CDDAxEnable ACC_Driveoff_Request ACC_RollingCounter_id2E4 ACC_RollingCounter_id2E5 ACC_TrqEnable /end REF_MEASUREMENT
/end GROUP
/begin GROUP S28_Server_Status "VCU_CS75_12_30_test/长安CS75底盘程序，20ms一次/APP/Monitor/Server_Status" /begin REF_MEASUREMENT A1counter Server_CommunicationStatus counter3 /end REF_MEASUREMENT /end GROUP
/begin GROUP S28_Vehicle_Status "VCU_CS75_12_30_test/长安CS75底盘程序，20ms一次/APP/Monitor/Vehicle_Status"
 /begin REF_MEASUREMENT EPS_AvailabilityStatus VehicleCommunicationStatus VehicleFaultStatus counter1 /end REF_MEASUREMENT
/end GROUP
/begin GROUP S62_EMS_255 "VCU_CS75_12_30_test/长安CS75底盘程序，20ms一次/Input/CAN1_Rx/EMS_255" /begin SUB_GROUP S85_ReceiveMessages /end SUB_GROUP /end GROUP
/begin GROUP S62_EPB_256 "VCU_CS75_12_30_test/长安CS75底盘程序，20ms一次/Input/CAN1_Rx/EPB_256" /begin SUB_GROUP S88_ReceiveMessages /end SUB_GROUP /end GROUP
/begin GROUP S62_SAS_108 "VCU_CS75_12_30_test/长安CS75底盘程序，20ms一次/Input/CAN1_Rx/SAS_108" /begin SUB_GROUP S103_ReceiveMessages /end SUB_GROUP /end GROUP
/begin GROUP S693_to511 "VCU_CS75_12_30_test/长安CS75底盘程序，20ms一次/Output/CAN0_Tx/to511"
 /begin REF_MEASUREMENT EMS_FrictionalTroq EMS_FullLoadIndicatedTroq EMS_IndicatedRealTroq EMS_TorqueConstant /end REF_MEASUREMENT
/end GROUP
/begin GROUP S85_ReceiveMessages "VCU_CS75_12_30_test/长安CS75底盘程序，20ms一次/Input/CAN1_Rx/EMS_255/ReceiveMessages" /begin SUB_GROUP S166_Subsystem /end SUB_GROUP /end GROUP
/begin GROUP S88_ReceiveMessages "VCU_CS75_12_30_test/长安CS75底盘程序，20ms一次/Input/CAN1_Rx/EPB_256/ReceiveMessages" /begin SUB_GROUP S187_Subsystem /end SUB_GROUP /end GROUP
/begin GROUP S103_ReceiveMessages "VCU_CS75_12_30_test/长安CS75底盘程序，20ms一次/Input/CAN1_Rx/SAS_108/ReceiveMessages" /begin SUB_GROUP S366_Subsystem /end SUB_GROUP /end GROUP
/begin GROUP S166_Subsystem "VCU_CS75_12_30_test/长安CS75底盘程序，20ms一次/Input/CAN1_Rx/EMS_255/ReceiveMessages/Subsystem" /begin SUB_GROUP S167_EMS /end SUB_GROUP /end GROUP
/begin GROUP S187_Subsystem "VCU_CS75_12_30_test/长安CS75底盘程序，20ms一次/Input/CAN1_Rx/EPB_256/ReceiveMessages/Subsystem" /begin SUB_GROUP S188_EPB /end SUB_GROUP /end GROUP
/begin GROUP S366_Subsystem "VCU_CS75_12_30_test/长安CS75底盘程序，20ms一次/Input/CAN1_Rx/SAS_108/ReceiveMessages/Subsystem" /begin SUB_GROUP S367_SAS_2 /end SUB_GROUP /end GROUP
/begin GROUP S167_EMS "VCU_CS75_12_30_test/长安CS75底盘程序，20ms一次/Input/CAN1_Rx/EMS_255/ReceiveMessages/Subsystem/EMS" /begin REF_MEASUREMENT EMS_BrakePedalStatus /end REF_MEASUREMENT /end GROUP
/begin GROUP S188_EPB "VCU_CS75_12_30_test/长安CS75底盘程序，20ms一次/Input/CAN1_Rx/EPB_256/ReceiveMessages/Subsystem/EPB" /begin REF_MEASUREMENT EPB_RollingCounter_id256 /end REF_MEASUREMENT /end GROUP
/begin GROUP S367_SAS_2 "VCU_CS75_12_30_test/长安CS75底盘程序，20ms一次/Input/CAN1_Rx/SAS_108/ReceiveMessages/Subsystem/SAS_2" /begin REF_MEASUREMENT SAS_SteeringAngle /end REF_MEASUREMENT /end GROUP
/end MODULE
/end PROJECT
/* (add any file trailer comments here) */
/* EOF VCU_CS75_12_30_test.a2l */
