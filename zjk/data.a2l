/******************************************************************************
* ASAP2 file: VCU_CS75_9_30.a2l
* Code generation for model "VCU_CS75_9_30".
* Model version : 1.2425
* Simulink Coder version : 8.6 (R2014a) 27-Dec-2013
* C source code generated on : Wed Oct 07 21:32:25 2020
* Target selection: ec5744.tlc
* Embedded hardware selection: Freescale MPC5500
* Code generation objectives: Unspecified
* Validation result: Not run
* (add additional file header information here)
******************************************************************************/ ASAP2_VERSION 1 31
/* Version 1.31 */
/begin PROJECT ECUCoderProject "ECUCoder Project"
/begin HEADER "Header Comments go here" /end HEADER
/begin MODULE ModuleName "No Comment"
/begin MOD_PAR "No Comment" /end MOD_PAR
/begin MOD_COMMON "No Comment" BYTE_ORDER MSB_FIRST /end MOD_COMMON
/begin RECORD_LAYOUT Scalar_BOOLEAN FNC_VALUES 1 UBYTE COLUMN_DIR DIRECT /end RECORD_LAYOUT
/begin RECORD_LAYOUT Scalar_UBYTE FNC_VALUES 1 UBYTE COLUMN_DIR DIRECT /end RECORD_LAYOUT
/begin RECORD_LAYOUT Scalar_BYTE FNC_VALUES 1 SBYTE COLUMN_DIR DIRECT /end RECORD_LAYOUT
/begin RECORD_LAYOUT Scalar_UWORD FNC_VALUES 1 UWORD COLUMN_DIR DIRECT /end RECORD_LAYOUT
/begin RECORD_LAYOUT Scalar_SWORD FNC_VALUES 1 SWORD COLUMN_DIR DIRECT /end RECORD_LAYOUT
/begin RECORD_LAYOUT Scalar_ULONG FNC_VALUES 1 ULONG COLUMN_DIR DIRECT /end RECORD_LAYOUT
/begin RECORD_LAYOUT Scalar_LONG FNC_VALUES 1 SLONG COLUMN_DIR DIRECT /end RECORD_LAYOUT
/begin RECORD_LAYOUT Scalar_FLOAT32_IEEE FNC_VALUES 1 FLOAT32_IEEE COLUMN_DIR DIRECT /end RECORD_LAYOUT
/begin RECORD_LAYOUT Scalar_FLOAT64_IEEE FNC_VALUES 1 FLOAT64_IEEE COLUMN_DIR DIRECT /end RECORD_LAYOUT
/begin RECORD_LAYOUT Lookup1D_BYTE FNC_VALUES 1 SBYTE COLUMN_DIR DIRECT /end RECORD_LAYOUT
/begin RECORD_LAYOUT Lookup1D_X_BYTE AXIS_PTS_X 1 SBYTE INDEX_INCR DIRECT /end RECORD_LAYOUT
/begin RECORD_LAYOUT Lookup1D_UBYTE FNC_VALUES 1 UBYTE COLUMN_DIR DIRECT /end RECORD_LAYOUT
/begin RECORD_LAYOUT Lookup1D_X_UBYTE AXIS_PTS_X 1 UBYTE INDEX_INCR DIRECT /end RECORD_LAYOUT
/begin RECORD_LAYOUT Lookup1D_UWORD FNC_VALUES 1 UWORD COLUMN_DIR DIRECT /end RECORD_LAYOUT
/begin RECORD_LAYOUT Lookup1D_X_UWORD AXIS_PTS_X 1 UWORD INDEX_INCR DIRECT /end RECORD_LAYOUT
/begin RECORD_LAYOUT Lookup1D_WORD FNC_VALUES 1 SWORD COLUMN_DIR DIRECT /end RECORD_LAYOUT
/begin RECORD_LAYOUT Lookup1D_X_WORD AXIS_PTS_X 1 SWORD INDEX_INCR DIRECT /end RECORD_LAYOUT
/begin RECORD_LAYOUT Lookup1D_ULONG FNC_VALUES 1 ULONG COLUMN_DIR DIRECT /end RECORD_LAYOUT
/begin RECORD_LAYOUT Lookup1D_X_ULONG AXIS_PTS_X 1 ULONG INDEX_INCR DIRECT /end RECORD_LAYOUT
/begin RECORD_LAYOUT Lookup1D_SLONG FNC_VALUES 1 SLONG COLUMN_DIR DIRECT /end RECORD_LAYOUT
/begin RECORD_LAYOUT Lookup1D_X_LONG AXIS_PTS_X 1 SLONG INDEX_INCR DIRECT /end RECORD_LAYOUT
/begin RECORD_LAYOUT Lookup1D_FLOAT32_IEEE FNC_VALUES 1 FLOAT32_IEEE COLUMN_DIR DIRECT /end RECORD_LAYOUT
/begin RECORD_LAYOUT Lookup1D_X_FLOAT32_IEEE AXIS_PTS_X 1 FLOAT32_IEEE INDEX_INCR DIRECT /end RECORD_LAYOUT
/begin RECORD_LAYOUT Lookup1D_FLOAT64_IEEE FNC_VALUES 1 FLOAT64_IEEE COLUMN_DIR DIRECT /end RECORD_LAYOUT
/begin RECORD_LAYOUT Lookup1D_X_FLOAT64_IEEE AXIS_PTS_X 1 FLOAT64_IEEE INDEX_INCR DIRECT /end RECORD_LAYOUT
/begin RECORD_LAYOUT Lookup2D_UBYTE FNC_VALUES 1 UBYTE COLUMN_DIR DIRECT /end RECORD_LAYOUT
/begin RECORD_LAYOUT Lookup2D_X_UBYTE AXIS_PTS_X 1 UBYTE INDEX_INCR DIRECT /end RECORD_LAYOUT
/begin RECORD_LAYOUT Lookup2D_BYTE FNC_VALUES 1 SBYTE COLUMN_DIR DIRECT /end RECORD_LAYOUT
/begin RECORD_LAYOUT Lookup2D_X_BYTE AXIS_PTS_X 1 SBYTE INDEX_INCR DIRECT /end RECORD_LAYOUT
/begin RECORD_LAYOUT Lookup2D_UWORD FNC_VALUES 1 UWORD COLUMN_DIR DIRECT /end RECORD_LAYOUT
/begin RECORD_LAYOUT Lookup2D_X_UWORD AXIS_PTS_X 1 UWORD INDEX_INCR DIRECT /end RECORD_LAYOUT
/begin RECORD_LAYOUT Lookup2D_WORD FNC_VALUES 1 SWORD COLUMN_DIR DIRECT /end RECORD_LAYOUT
/begin RECORD_LAYOUT Lookup2D_X_WORD AXIS_PTS_X 1 SWORD INDEX_INCR DIRECT /end RECORD_LAYOUT
/begin RECORD_LAYOUT Lookup2D_ULONG FNC_VALUES 1 ULONG COLUMN_DIR DIRECT /end RECORD_LAYOUT
/begin RECORD_LAYOUT Lookup2D_X_ULONG AXIS_PTS_X 1 ULONG INDEX_INCR DIRECT /end RECORD_LAYOUT
/begin RECORD_LAYOUT Lookup2D_LONG FNC_VALUES 1 SLONG COLUMN_DIR DIRECT /end RECORD_LAYOUT
/begin RECORD_LAYOUT Lookup2D_X_LONG AXIS_PTS_X 1 SLONG INDEX_INCR DIRECT /end RECORD_LAYOUT
/begin RECORD_LAYOUT Lookup2D_FLOAT32_IEEE FNC_VALUES 1 FLOAT32_IEEE COLUMN_DIR DIRECT /end RECORD_LAYOUT
/begin RECORD_LAYOUT Lookup2D_X_FLOAT32_IEEE AXIS_PTS_X 1 FLOAT32_IEEE INDEX_INCR DIRECT /end RECORD_LAYOUT
/begin RECORD_LAYOUT Lookup2D_FLOAT64_IEEE FNC_VALUES 1 FLOAT64_IEEE COLUMN_DIR DIRECT /end RECORD_LAYOUT
/begin RECORD_LAYOUT Lookup2D_X_FLOAT64_IEEE AXIS_PTS_X 1 FLOAT64_IEEE INDEX_INCR DIRECT /end RECORD_LAYOUT
/begin MEASUREMENT AutoDrivingReady "" FLOAT64_IEEE VCU_CS75_9_30_CM_double 0 0 -1.7E+308 1.7E+308 ECU_ADDRESS 0x40001178 /end MEASUREMENT
/begin MEASUREMENT RemoteAcclPosition "" FLOAT64_IEEE VCU_CS75_9_30_CM_double 0 0 -1.7E+308 1.7E+308 ECU_ADDRESS 0x40001160 /end MEASUREMENT
/begin MEASUREMENT LaterlAngleCommand "" FLOAT64_IEEE VCU_CS75_9_30_CM_double 0 0 -1.7E+308 1.7E+308 ECU_ADDRESS 0x40001170 /end MEASUREMENT
/begin MEASUREMENT P6_Value "" FLOAT64_IEEE VCU_CS75_9_30_CM_double 0 0 -1.7E+308 1.7E+308 ECU_ADDRESS 0x40001168 /end MEASUREMENT
/begin MEASUREMENT EPS_APA_ControlFeedback "" FLOAT64_IEEE VCU_CS75_9_30_CM_double 0 0 -1.7E+308 1.7E+308 ECU_ADDRESS 0x40001158 /end MEASUREMENT
/begin MEASUREMENT TakeOver1 "" FLOAT64_IEEE VCU_CS75_9_30_CM_double 0 0 -1.7E+308 1.7E+308 ECU_ADDRESS 0x40001118 /end MEASUREMENT
/begin MEASUREMENT System_State "" FLOAT64_IEEE VCU_CS75_9_30_CM_double 0 0 -1.7E+308 1.7E+308 ECU_ADDRESS 0x400011a0 /end MEASUREMENT
/begin MEASUREMENT counter1 "" FLOAT64_IEEE VCU_CS75_9_30_CM_double 0 0 -1.7E+308 1.7E+308 ECU_ADDRESS 0x40001138 /end MEASUREMENT
/begin MEASUREMENT VehicleCommunicationStatus "" FLOAT64_IEEE VCU_CS75_9_30_CM_double 0 0 -1.7E+308 1.7E+308 ECU_ADDRESS 0x40001150 /end MEASUREMENT
/begin MEASUREMENT VehicleFaultStatus "" FLOAT64_IEEE VCU_CS75_9_30_CM_double 0 0 -1.7E+308 1.7E+308 ECU_ADDRESS 0x40001188 /end MEASUREMENT
/begin MEASUREMENT counter2 "" FLOAT64_IEEE VCU_CS75_9_30_CM_double 0 0 -1.7E+308 1.7E+308 ECU_ADDRESS 0x400011c0 /end MEASUREMENT
/begin MEASUREMENT Server_CommunicationStatus "" FLOAT64_IEEE VCU_CS75_9_30_CM_double 0 0 -1.7E+308 1.7E+308 ECU_ADDRESS 0x40001148 /end MEASUREMENT
/begin MEASUREMENT counter3 "" FLOAT64_IEEE VCU_CS75_9_30_CM_double 0 0 -1.7E+308 1.7E+308 ECU_ADDRESS 0x40001110 /end MEASUREMENT
/begin MEASUREMENT ACC_TrqEnable "" FLOAT64_IEEE VCU_CS75_9_30_CM_double 0 0 -1.7E+308 1.7E+308 ECU_ADDRESS 0x400011a8 /end MEASUREMENT
/begin MEASUREMENT ACC_AccTorqueReq "" FLOAT64_IEEE VCU_CS75_9_30_CM_double 0 0 -1.7E+308 1.7E+308 ECU_ADDRESS 0x40001108 /end MEASUREMENT
/begin MEASUREMENT ACC_RollingCounter_id2E5 "" FLOAT64_IEEE VCU_CS75_9_30_CM_double 0 0 -1.7E+308 1.7E+308 ECU_ADDRESS 0x40001180 /end MEASUREMENT
/begin MEASUREMENT ACC_RollingCounter_id2E4 "" FLOAT64_IEEE VCU_CS75_9_30_CM_double 0 0 -1.7E+308 1.7E+308 ECU_ADDRESS 0x400011b8 /end MEASUREMENT
/begin MEASUREMENT ACC_ACCTargetAcceleration "" FLOAT64_IEEE VCU_CS75_9_30_CM_double 0 0 -1.7E+308 1.7E+308 ECU_ADDRESS 0x40001120 /end MEASUREMENT
/begin MEASUREMENT ACC_Driveoff_Request "" FLOAT64_IEEE VCU_CS75_9_30_CM_double 0 0 -1.7E+308 1.7E+308 ECU_ADDRESS 0x400011b0 /end MEASUREMENT
/begin MEASUREMENT ACC_CDDAxEnable "" FLOAT64_IEEE VCU_CS75_9_30_CM_double 0 0 -1.7E+308 1.7E+308 ECU_ADDRESS 0x40001130 /end MEASUREMENT
/begin MEASUREMENT APA_RollingCounter "" FLOAT64_IEEE VCU_CS75_9_30_CM_double 0 0 -1.7E+308 1.7E+308 ECU_ADDRESS 0x40001198 /end MEASUREMENT
/begin MEASUREMENT APA_EPSAngleReq "" FLOAT64_IEEE VCU_CS75_9_30_CM_double 0 0 -1.7E+308 1.7E+308 ECU_ADDRESS 0x40001140 /end MEASUREMENT
/begin MEASUREMENT LAS_LDWVibrationWarning "" FLOAT64_IEEE VCU_CS75_9_30_CM_double 0 0 -1.7E+308 1.7E+308 ECU_ADDRESS 0x40001190 /end MEASUREMENT
/begin MEASUREMENT LAS_LDWStatus "" FLOAT64_IEEE VCU_CS75_9_30_CM_double 0 0 -1.7E+308 1.7E+308 ECU_ADDRESS 0x40001128 /end MEASUREMENT
/begin COMPU_METHOD /* Name of CompuMethod */ VCU_CS75_9_30_CM_double "Q = V" /* Conversion Type */ RAT_FUNC /* Format */ "%15.10" /* Units */ "" /* Coefficients */ COEFFS 0 1 0 0 0 1 /end COMPU_METHOD
/begin GROUP VCU_CS75_9_30 "VCU_CS75_9_30" /* Root */ ROOT /begin SUB_GROUP Root___CS75_____20ms__ /end SUB_GROUP /end GROUP
/begin GROUP Root___CS75_____20ms__ "VCU_CS75_9_30/长安CS75底盘程序，20ms一次" /begin SUB_GROUP S2_APP S2_BSW_Input /end SUB_GROUP /end GROUP
/begin GROUP S2_APP "VCU_CS75_9_30/长安CS75底盘程序，20ms一次/APP" /begin SUB_GROUP S23_Controller S23_Monitor S23_System_State_Manager /end SUB_GROUP /end GROUP
/begin GROUP S2_BSW_Input "VCU_CS75_9_30/长安CS75底盘程序，20ms一次/BSW_Input" /begin SUB_GROUP S24_ADC_Input S24_CAN0_Rx /end SUB_GROUP /end GROUP
/begin GROUP S23_Controller "VCU_CS75_9_30/长安CS75底盘程序，20ms一次/APP/Controller" /begin SUB_GROUP S26_Accesories S26_Lateral S26_Longitudinal /end SUB_GROUP /end GROUP
/begin GROUP S23_Monitor "VCU_CS75_9_30/长安CS75底盘程序，20ms一次/APP/Monitor"
 /begin SUB_GROUP S27_Server_Status S27_Vehicle_Status S27_Vehicle_Takeover_Status /end SUB_GROUP
/end GROUP
/begin GROUP S23_System_State_Manager "VCU_CS75_9_30/长安CS75底盘程序，20ms一次/APP/System_State_Manager" /begin REF_MEASUREMENT System_State /end REF_MEASUREMENT /end GROUP
/begin GROUP S24_ADC_Input "VCU_CS75_9_30/长安CS75底盘程序，20ms一次/BSW_Input/ADC_Input" /begin REF_MEASUREMENT P6_Value /end REF_MEASUREMENT /end GROUP
/begin GROUP S24_CAN0_Rx "VCU_CS75_9_30/长安CS75底盘程序，20ms一次/BSW_Input/CAN0_Rx" /begin SUB_GROUP S60_A1_801 /end SUB_GROUP /end GROUP
/begin GROUP S26_Accesories "VCU_CS75_9_30/长安CS75底盘程序，20ms一次/APP/Controller/Accesories" /begin REF_MEASUREMENT LAS_LDWStatus LAS_LDWVibrationWarning /end REF_MEASUREMENT /end GROUP
/begin GROUP S26_Lateral "VCU_CS75_9_30/长安CS75底盘程序，20ms一次/APP/Controller/Lateral" /begin REF_MEASUREMENT APA_EPSAngleReq APA_RollingCounter /end REF_MEASUREMENT /end GROUP
/begin GROUP S26_Longitudinal "VCU_CS75_9_30/长安CS75底盘程序，20ms一次/APP/Controller/Longitudinal"
 /begin REF_MEASUREMENT ACC_ACCTargetAcceleration ACC_AccTorqueReq ACC_CDDAxEnable ACC_Driveoff_Request ACC_RollingCounter_id2E4 ACC_RollingCounter_id2E5 ACC_TrqEnable /end REF_MEASUREMENT
/end GROUP
/begin GROUP S27_Server_Status "VCU_CS75_9_30/长安CS75底盘程序，20ms一次/APP/Monitor/Server_Status" /begin REF_MEASUREMENT Server_CommunicationStatus counter3 /end REF_MEASUREMENT /end GROUP
/begin GROUP S27_Vehicle_Status "VCU_CS75_9_30/长安CS75底盘程序，20ms一次/APP/Monitor/Vehicle_Status"
 /begin REF_MEASUREMENT EPS_APA_ControlFeedback VehicleCommunicationStatus VehicleFaultStatus counter1 counter2 /end REF_MEASUREMENT
/end GROUP
/begin GROUP S27_Vehicle_Takeover_Status "VCU_CS75_9_30/长安CS75底盘程序，20ms一次/APP/Monitor/Vehicle_Takeover_Status" /begin REF_MEASUREMENT TakeOver1 /end REF_MEASUREMENT /end GROUP
/begin GROUP S60_A1_801 "VCU_CS75_9_30/长安CS75底盘程序，20ms一次/BSW_Input/CAN0_Rx/A1_801" /begin SUB_GROUP S65_ReceiveMessages /end SUB_GROUP /end GROUP
/begin GROUP S65_ReceiveMessages "VCU_CS75_9_30/长安CS75底盘程序，20ms一次/BSW_Input/CAN0_Rx/A1_801/ReceiveMessages" /begin SUB_GROUP S66_Subsystem /end SUB_GROUP /end GROUP
/begin GROUP S66_Subsystem "VCU_CS75_9_30/长安CS75底盘程序，20ms一次/BSW_Input/CAN0_Rx/A1_801/ReceiveMessages/Subsystem" /begin REF_MEASUREMENT AutoDrivingReady LaterlAngleCommand RemoteAcclPosition /end REF_MEASUREMENT /end GROUP
/end MODULE
/end PROJECT
/* (add any file trailer comments here) */
/* EOF VCU_CS75_9_30.a2l */
